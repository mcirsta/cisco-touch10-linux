// SPDX-License-Identifier: GPL-2.0-only
// Cold-start recovery using the mainline OMAP WDT2 driver.
#include "../perrier-thermal/omap4-perrier-thermal.dts"

&{/} {
    // The legacy /ocp hierarchy stays disabled. Match the upstream OMAP4
    // WDT2 target description at its physical address. Preserve a timer
    // inherited through kexec until omap_wdt deliberately takes ownership.
    target-module@4a314000 {
        compatible = "ti,sysc-omap2", "ti,sysc";
        reg = <0x4a314000 4>, <0x4a314010 4>, <0x4a314014 4>;
        reg-names = "rev", "sysc", "syss";
        ti,no-reset-on-init;
        ti,no-idle-on-init;
        ti,sysc-mask = <(SYSC_OMAP2_EMUFREE | SYSC_OMAP2_SOFTRESET)>;
        ti,sysc-sidle = <SYSC_IDLE_FORCE>, <SYSC_IDLE_NO>,
                        <SYSC_IDLE_SMART>, <SYSC_IDLE_SMART_WKUP>;
        ti,syss-mask = <1>;
        clocks = <&l4_wkup_clkctrl OMAP4_WD_TIMER2_CLKCTRL 0>;
        clock-names = "fck";
        #address-cells = <1>;
        #size-cells = <1>;
        ranges = <0 0x4a314000 0x1000>;
        watchdog@0 {
            compatible = "ti,omap4-wdt", "ti,omap3-wdt";
            reg = <0 0x80>;
            interrupts = <GIC_SPI 80 IRQ_TYPE_LEVEL_HIGH>;
            timeout-sec = <120>;
        };
    };
};
